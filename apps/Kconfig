## apps/Kconfig
```kconfig
menu "External Applications"

source "$APPSBINDIR/external/imu/Kconfig"

endmenu # External Applications
```

## apps/battery/Kconfig
```kconfig
config APP_BATTERY
	tristate "Battery test utility"
	default n
	---help---
		Read battery gauge and charger status via NuttX battery
		framework IOCTL commands (/dev/bat0, /dev/charge0).
```

## apps/btsensor/Kconfig
```kconfig
config APP_BTSENSOR
	tristate "SPP IMU streaming (btstack, Issue #52)"
	default n
	---help---
		SPIKE Prime Hub Classic Bluetooth SPP (RFCOMM) streaming of
		LSM6DS3TR-C IMU samples.  Requires the CC2564C bring-up in
		boards/spike-prime-hub (Issue #47) and btstack integrated
		under libs/btstack.  Step B skeleton only; activating the
		service happens in Step D.

if APP_BTSENSOR

config APP_BTSENSOR_PROGNAME
	string "Program name"
	default "btsensor"
	depends on BUILD_KERNEL
	---help---
		NSH command name.

config APP_BTSENSOR_PRIORITY
	int "Task priority"
	default 100

config APP_BTSENSOR_STACKSIZE
	int "Task stack size"
	default 4096

config APP_BTSENSOR_BUNDLE_TICK_MS
	int "BUNDLE frame emission period (ms)"
	default 10
	range 5 100
	---help---
		Period of the BUNDLE wire frame emitter.  Default 10 ms
		gives the 100 Hz cadence the host viewer expects.  Lower
		values increase BT bandwidth pressure; higher values
		reduce bandwidth but decimate IMU samples (max 8 per
		BUNDLE).  Issue #88.

config APP_BTSENSOR_RING_DEPTH
	int "Frame ring buffer depth"
	default 32
	range 4 128
	---help---
		Number of frames kept between the BUNDLE emitter and
		the RFCOMM send worker.  Default 32 covers ~320 ms of
		100 Hz emission; deeper rings tolerate longer RF stalls
		at the cost of RAM.  Each slot is BTSENSOR_TX_FRAME_MAX_SIZE
		bytes (1408 in Issue #88).  The 32-frame default matches
		main's pre-#88 layout to avoid an intermittent boot
		failure observed when shrinking the user-space BSS by
		~33 KB; the cause is not yet root-caused but is likely a
		RAM-layout interaction during user-space init.

config APP_BTSENSOR_BTN_LONG_PRESS_MS
	int "BT button long-press threshold (ms)"
	default 1500
	range 200 5000
	---help---
		Hold the BT button down at least this long for a
		long-press event; shorter presses register as short.
		Long press toggles BT off when paired or advertising;
		short press starts advertising from BT off.

config APP_BTSENSOR_LED_BLINK_PERIOD_MS
	int "BT LED slow-blink period (ms)"
	default 1000
	range 100 3000
	---help---
		Period of the BT LED blink while advertising
		(half on / half off).

config APP_BTSENSOR_LED_FAIL_BLINKS
	int "BT LED fail-blink pulse count"
	default 3
	range 1 10
	---help---
		Number of short blue blinks emitted when SSP pairing
		fails before the LED returns to off.

config APP_BTSENSOR_SHELL_MODE
	bool "BT-side NSH shell over SPP (Issue #108)"
	default n
	select PIPES
	---help---
		Mutually exclusive `MODE SHELL` / `MODE TELEMETRY` switch
		on the existing SPP/RFCOMM channel.  When the peer sends
		`MODE SHELL\n` the daemon stops the IMU/SENSOR pumps and
		bridges the byte stream to a freshly-spawned NSH child via
		FIFOs (/dev/btnsh_in, /dev/btnsh_out).  Returns to
		telemetry mode on `exit` from the shell or RFCOMM peer
		drop.  USB-side NSH (/dev/console) is unaffected.

if APP_BTSENSOR_SHELL_MODE

config APP_BTSENSOR_SHELL_TX_BUF
	int "Shell TX coalescing buffer (bytes)"
	default 4096
	range 256 32768
	---help---
		Size of the coalescing buffer that holds NSH stdout bytes
		between the reader pthread and the BTstack thread that
		drives rfcomm_send().  4096 covers everyday short-output
		commands.  Larger snapshots (a full RAMLOG `dmesg`) over-run
		this buffer and the reader drops the tail, but the shell
		session itself stays usable — bump only if you need to
		capture every byte of a large dump.  TX throttle and the
		frame-size cap below pace the actual radio output to avoid
		the CC2564C ACL TX queue stall (Issue #54 / #109).

config APP_BTSENSOR_SHELL_TX_FRAME_BYTES
	int "Shell rfcomm_send frame size cap (bytes)"
	default 256
	range 64 1016
	---help---
		Per-call upper bound on the byte count handed to
		rfcomm_send() from the shell pump.  RFCOMM negotiates
		up to 1016 B per frame, but the CC2564C controller has
		only HC_Total_Num_ACL_Data_Packets=4 ACL TX slots and a
		burst of MTU-sized frames stalls the controller until
		link supervision timeout (Issue #54 / #109 root cause).
		Smaller frames trade per-byte overhead for shorter slot
		occupancy and better resilience against the stall.  256 B
		gives ~4 frames per slot turnover for `dmesg`-class
		output without hitting the stall trigger.

config APP_BTSENSOR_SHELL_THROTTLE_MS
	int "Shell pump timer interval (ms)"
	default 5
	range 1 500
	---help---
		Inter-send delay between successive RFCOMM_REQUEST_CAN_SEND_NOW
		fires from the shell TX pump.  Throttling gives the
		controller a window to drain the previous ACL packet before
		the next one is offered, avoiding the CC2564C ACL TX queue
		stall (Issue #54).  Combined with the 256 B frame cap, 5 ms
		is enough headroom on a 4-slot controller queue.

config APP_BTSENSOR_SHELL_NSH_STACK
	int "NSH child task stack (bytes)"
	default 6144
	range 4096 16384
	---help---
		Stack size for the spawned NSH child task that runs the
		BT-side shell.  Tune with `nsh> ps` Stack used after
		exercising commands like `dmesg` or builtin apps.

config APP_BTSENSOR_SHELL_READER_STACK
	int "Shell reader pthread stack (bytes)"
	default 2048
	range 1024 8192
	---help---
		Stack size for the reader pthread that drains NSH
		stdout into the shell TX buffer.

endif # APP_BTSENSOR_SHELL_MODE

endif
```

## apps/capture/Kconfig
```kconfig
#
# apps/capture/Kconfig
#
# Capture library: a thin userspace wrapper around the kernel chardev
# /dev/btcap (Issue #122).  Used by apps/sensor's `do_capture` and any
# future capture client.  Has no MAIN/builtin of its own; toggling this
# Kconfig just builds the helpers into the apps library.
#

config APP_CAPTURE
	tristate "Userspace capture library (Issue #122)"
	default n
	depends on BOARD_BTCAP_CHARDEV
	---help---
		Wrapper around /dev/btcap that exposes the four-function
		capture lifecycle (init / write / deinit / abort) plus the
		.cap file header builder.  capture clients link this library
		statically; the library itself produces no NSH builtin.

if APP_CAPTURE

config APP_CAPTURE_MAX_HANDLES
	int "Maximum concurrent capture handles in this build"
	default 1
	---help---
		Process-wide cap on simultaneously active capture_init() calls.
		v1 ships with 1 (single-client, single-session) per the design;
		this knob is here so a future feature can bump it without
		touching every caller.  Library will reject capture_init beyond
		this count with -EMFILE.

config APP_CAPTURE_MAX_HEAP_BYTES
	int "Default heap budget per capture invocation (bytes)"
	default 65536
	---help---
		Advisory upper bound that capture clients (apps/sensor) use
		when sizing their malloc() for a capture buffer.  Set to a
		value that fits the worst-case usram budget on the target
		board.  The library itself does not enforce this — it is
		surfaced here so all clients agree on the same default.

		On spike-prime-hub the user heap has ~100 KB free at idle so
		64 KB is safe for a single in-flight session.  At 100 Hz with
		a 9 B record this lets `sensor color capture` go for ~72 s.

endif # APP_CAPTURE
```

## apps/crash/Kconfig
```kconfig
config APP_CRASH
	tristate "Crash test utility"
	default n
	---help---
		Trigger various crash types to verify panic syslog output.
```

## apps/crashme/Kconfig
```kconfig
config APP_CRASHME
	tristate "Crash test app"
	default n
	---help---
		Intentionally crashes the system for stack dump testing.
```

## apps/crashtest/Kconfig
```kconfig
config APP_CRASHTEST
	tristate "Crash test utility"
	default n
	---help---
		Trigger various crash types to verify panic syslog output.
```

## apps/drivebase/Kconfig
```kconfig
config APP_DRIVEBASE
	tristate "SPIKE Prime drivebase userspace daemon (Issue #77)"
	default n
	depends on BOARD_DRIVEBASE_CHARDEV
	depends on LEGO_SENSOR
	depends on STM32_I2C2  # board-local LSM6DSL uORB (sensor_imu0)
	---help---
		Userspace 5 ms control loop for the SPIKE Prime two-motor
		drivebase.  Talks to the kernel-side /dev/drivebase chardev
		(Issue #77, board-side) over DRIVEBASE_DAEMON_* ioctls and
		exposes the user-facing DRIVEBASE_DRIVE_STRAIGHT / TURN /
		FOREVER / STOP / etc verbs to user apps and the NSH CLI.

		The daemon owns the per-tick observer + trajectory + PID
		stack (re-implemented from pybricks pbio for SPIKE only —
		feature parity, no source copy) and routes encoder / IMU
		drain to LEGOSENSOR class topics + LSM6DSL uORB.  Motor
		actuation goes through LEGOSENSOR_SET_PWM /
		LEGOSENSOR_MOTOR_*_{COAST,BRAKE} on /dev/uorb/sensor_motor_l/r
		so the H-bridge driver only sees one CLAIM holder.

		Disable for boards that do not run the drivebase (mass-
		storage / sensor-only / non-spike boards).

if APP_DRIVEBASE

config APP_DRIVEBASE_CLI_PRIORITY
	int "drivebase CLI task priority"
	default 100
	range 50 200
	---help---
		Priority of the `drivebase` builtin CLI helper that issues
		ioctls to /dev/drivebase.  This is the user-side CLI only —
		the daemon's RT control loop runs at
		APP_DRIVEBASE_RT_PRIORITY (separate Kconfig, default 220).

config APP_DRIVEBASE_RT_PRIORITY
	int "RT control task priority (SCHED_FIFO)"
	default 220
	range 200 240
	---help---
		Priority of the 5 ms control loop pthread inside the daemon.
		Default 220 sits below HPWORK (224 — sound DMA softdog and
		legoport TX live there) and above LPWORK (176) plus BTstack
		main (100).  Lowering this risks deadline misses under audio
		/ flash load; raising past 224 can starve the audio path.

config APP_DRIVEBASE_RT_STACKSIZE
	int "RT control task stack size"
	default 4096
	range 2048 16384

config APP_DRIVEBASE_DAEMON_STACKSIZE
	int "Lifecycle / chardev daemon task stack size"
	default 4096
	range 2048 16384

config APP_DRIVEBASE_JITTER_RING_DEPTH
	int "Jitter ring depth (samples retained for DRIVEBASE_JITTER_DUMP)"
	default 256
	range 64 4096
	---help---
		Per-tick wake-latency samples kept by the daemon for the
		DRIVEBASE_JITTER_DUMP ioctl.  Larger rings cost RAM
		(8 B / sample) but capture longer load windows.

endif
```

## apps/imu/Kconfig
```kconfig
config APP_IMU
	tristate "IMU processing library"
	default n
	---help---
		IMU sensor fusion, calibration, and stationarity detection.
```

## apps/led/Kconfig
```kconfig
config APP_LED
	tristate "LED test utility"
	default n
	---help---
		Test TLC5955 LED driver: status/battery/BT LEDs, 5x5 matrix,
		rainbow, blink, and breathing animations.
```

## apps/legoport/Kconfig
```kconfig
config APP_LEGOPORT
	tristate "LEGO Powered Up I/O port utility"
	default n
	---help---
		CLI for inspecting and waiting on /dev/legoport0..5
		(Issue #42).  Subcommands: list, info, wait, stats.

		With CONFIG_LEGO_LUMP_DIAG=y, also exposes the
		`lump-hw dump` subcommand that triggers a kernel-side
		register dump for the 6 LUMP UARTs (Issue #43 Phase 1).
```

## apps/legosensor/Kconfig
```kconfig
config APP_LEGOSENSOR
	tristate "LEGO sensor uORB CLI utility"
	default n
	depends on LEGO_SENSOR
	---help---
		CLI for inspecting and controlling the per-class LEGO sensor
		uORB topics under /dev/uorb/sensor_{color,ultrasonic,force,
		motor_m,motor_r,motor_l} (Issue #79).  Subcommands per class:
		info, status, watch, select, send, pwm.

		`legosensor <class> watch` is the canonical end-to-end
		verification tool — `dd` and the standard `sensortest` are
		not compatible with the SENSOR_TYPE_CUSTOM uORB topic naming
		used here.
```

## apps/linetrace/Kconfig
```kconfig
config APP_LINETRACE
	tristate "Drivebase line trace user-space PID app"
	default n
	depends on APP_DRIVEBASE
	depends on LEGO_SENSOR
	---help---
		User-space NSH builtin that follows a line by issuing
		DRIVEBASE_DRIVE_FOREVER continuously while reading intensity
		samples from /dev/uorb/sensor_color (mode 5, RGB+I, INT16
		channel 4 = intensity, 0..1024).  Modeled on the pybricks
		`tests/motors/drivebase_line.py` pattern: a tight user-side
		`err = target - intensity(); drive(speed, err * Kp); wait(...)`
		loop.

		Subcommands:
		  linetrace cal              3 s sweep, prints black/white/midpoint
		  linetrace run <speed> <kp> [target] [--max-turn dps] [--hz N]
```

## apps/port/Kconfig
```kconfig
config APP_PORT
	tristate "LEGO Powered Up I/O port utility"
	default n
	---help---
		CLI for the LEGO Powered Up I/O port driver
		(/dev/legoport0..5).  Subcommands:

		    list / info <P> / wait <P> / stats   (Issue #42 DCM)
		    pwm <P> set/coast/brake/status       (Issue #80 H-bridge)
		    lump status                          (Issue #43 LUMP, global)
		    lump <P> info/set-mode/send/watch    (Issue #43 LUMP, per-port)
		    lump-hw dump                         (CONFIG_LEGO_LUMP_DIAG)

		Port arguments accept A..F / a..f / 0..5.

		WARNING: driving PWM into a non-motor LUMP device (SPIKE
		Color sensor type 61, Ultrasonic type 62, Force type 63,
		etc.) can damage it.  Motors are safe — both passive
		(M-motor 45303, Train motor 88011) and active SPIKE motors
		(M=48, L=49, S=65) are driven by the same H-bridge that
		pybricks uses.
```

## apps/sound/Kconfig
```kconfig
config APP_SOUND
	tristate "Sound test utility"
	default n
	---help---
		Play square-wave tones, tune strings, and control volume on the
		SPIKE Prime Hub speaker via /dev/tone0 and /dev/pcm0.
```

## boards/b-l4s5i-iot01a/Kconfig
```kconfig
#
# Board-specific Kconfig for B-L4S5I-IOT01A (L4R5 workaround)
#

if ARCH_BOARD_CUSTOM

config B_L4S5I_IOT01A_MTD_FLASH
	bool "MTD driver for external 64Mbit flash memory"
	default n
	select STM32L4_OCTOSPI
	select MTD
	select MTD_MX25RXX
	select FS_LITTLEFS
	---help---
		Configures an MTD device for use with the onboard MX25R6435F
		external flash using OctoSPI interface.

endif # ARCH_BOARD_CUSTOM
```
